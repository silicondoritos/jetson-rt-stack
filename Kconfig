## plugins/axelera/Kconfig
```kconfig
# Axelera plugin   sub-options, shown only when AXELERA_METIS is enabled.

if AXELERA_METIS

config AXELERA_PROMOTE_INTREE
    bool "Promote Axelera driver to in-tree build (vermagic safety)"
    default y
    help
      Creates a drivers/misc/axelera/ shim with Kconfig/Makefile wrappers
      that pull the vendor driver into the kernel's own build system. This
      guarantees the resulting metis.ko has a vermagic string that matches
      the running kernel. Disable only if managing the OOT build yourself.

config AXELERA_UDEV_RULES
    bool "Stage Axelera udev rules into rootfs"
    default y
    help
      Copies 72-axelera.rules from the axelera-driver tree into
      /etc/udev/rules.d/ so the Metis device node has correct permissions
      at first boot without requiring sudo for inference processes.

endif
```

## plugins/zedx/Kconfig
```kconfig
# ZED X plugin   sub-options, shown only when a ZED X camera is selected.

if CAMERA_ZEDX_MONO || CAMERA_ZEDX_DUO

config ZEDX_SDK_AUTO_INSTALL
    bool "Auto-install ZED SDK at first-boot"
    default y
    help
      Stages the ZED_SDK_Tegra_*.run installer from the zed-sdk vendor
      tree into rootfs at bake time and runs it at first-boot with
      --skip_drivers (kernel driver is in-tree). If no .run file is
      present at bake time, first-boot skips SDK installation silently.

config ZEDX_DTBO_NAME
    string "ZED X overlay DTBO filename"
    default "tegra234-p3768-camera-zedlink-mono-sl-overlay.dtbo"
    help
      Filename of the compiled DTBO to stage into /boot/ and register in
      extlinux.conf. Built by Phase 2 from the Stereolabs DTS source.

endif
```
